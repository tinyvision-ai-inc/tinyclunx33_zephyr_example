## drivers/video/Kconfig
```kconfig
# Copyright (c) 2024 tinyVision.ai Inc.
# SPDX-License-Identifier: Apache-2.0

if VIDEO

rsource "Kconfig.customcore"

endif
```

## drivers/video/Kconfig.ar0144
```kconfig
# Copyright (c) 2025 tinyVision.ai Inc.
# SPDX-License-Identifier: Apache-2.0

config VIDEO_AR0144
	bool "AR0144"
	depends on DT_HAS_TINYVISION_AR0144_ENABLED
	default y
	help
	  Enable driver for the AR0144 camera.
```

## drivers/video/Kconfig.customcore
```kconfig
# Copyright (c) 2024 tinyVision.ai Inc.
# SPDX-License-Identifier: Apache-2.0

config VIDEO_TINYVISION_CUSTOMCORE
	bool "Example of custom RTL defined by the application"
	depends on DT_HAS_TINYVISION_CUSTOMCORE_ENABLED
	default y
	help
	  Enable driver for an application-specific FPGA peripheral.
```

## drivers/video/Kconfig.example
```kconfig
# Copyright (c) 2024 tinyVision.ai Inc.
# SPDX-License-Identifier: Apache-2.0

config VIDEO_TINYVISION_EXAMPLE
	bool "Example of custom RTL defined by the application"
	depends on DT_HAS_TINYVISION_EXAMPLE_ENABLED
	default y
	help
	  Enable driver for an application-specific FPGA peripheral.
```
