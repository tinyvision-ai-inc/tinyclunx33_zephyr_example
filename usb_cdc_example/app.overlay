zephyr_udc0: &usb0 {
	num-bidir-endpoints = <3>;
	num-endpoint-trb = <2 2  10 10  10 10>;
	maximum-speed = "super-speed";

	raw0: zephyr_cdc_raw_0 {
		compatible = "zephyr,cdc-raw";
		status = "okay";
	};
};
