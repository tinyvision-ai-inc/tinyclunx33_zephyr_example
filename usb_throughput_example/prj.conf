## CMakeLists.txt
```
cmake_minimum_required(VERSION 3.20.0)
set(CONF_FILE prj.conf ../litex.conf)
set(DTC_OVERLAY_FILE app.overlay ../litex.overlay)
set(BOARD_LINKER_SCRIPT ${CMAKE_CURRENT_SOURCE_DIR}/../linker.ld)
find_package(Zephyr REQUIRED HINTS $ENV{ZEPHYR_BASE})
project(app)
target_sources(app PRIVATE src/main.c)
```

## prj.conf
```kconfig
CONFIG_ASSERT=y
CONFIG_BOOT_BANNER=n
CONFIG_CLOCK_CONTROL=y
CONFIG_CLOCK_CONTROL_LOG_LEVEL_INF=y
CONFIG_CLOCK_CONTROL_SI5351=y
CONFIG_GPIO=n
CONFIG_I2C=y
CONFIG_I2C_INIT_PRIORITY=0
CONFIG_I2C_SHELL=y
CONFIG_KERNEL_SHELL=y
CONFIG_LOG=y
CONFIG_LOG_MODE_MINIMAL=y
CONFIG_NET_BUF_POOL_USAGE=y
CONFIG_SERIAL=y
CONFIG_SHELL=y
CONFIG_SPI=n
CONFIG_UART_LINE_CTRL=y
CONFIG_UDC_BUF_COUNT=32
CONFIG_UDC_DRIVER_LOG_LEVEL_DBG=y
CONFIG_UDC_USB23=y
CONFIG_USBD_LOG_LEVEL_INF=y
CONFIG_USBD_SHELL=y
CONFIG_USBD_CDC_RAW_CLASS=y
CONFIG_USBD_CDC_RAW_LOG_LEVEL_INF=y
CONFIG_USB_DEVICE_STACK_NEXT=y
CONFIG_XIP=y
```

## app.overlay
```dts
zephyr_udc0: &usb0 {
	num-bidir-endpoints = <3>;
	num-endpoint-trb = <2 2  3 3  3 400>;
	maximum-speed = "super-speed";

	zephyr_cdc_raw_0 {
		compatible = "zephyr,cdc-raw";
		status = "okay";
	};
};
```

## src/main.c
```c
#include <zephyr/kernel.h>
#include <zephyr/devicetree.h>
#include <zephyr/drivers/clock_control.h>
#include <zephyr/drivers/usb/udc.h>
#include <zephyr/usb/usbd.h>
#include <zephyr/usb/bos.h>
#include <zephyr/usb/class/usb_cdc_raw.h>

#include <zephyr/logging/log.h>
LOG_MODULE_REGISTER(main, LOG_LEVEL_DBG);

USBD_DEVICE_DEFINE(my_usbd, DEVICE_DT_GET(DT_NODELABEL(zephyr_udc0)), 0x1209, 0x0001);
USBD_DEVICE_QUALIFIER_DEFINE(my_usbd_dev_qualifier);
USBD_CONFIGURATION_DEFINE(my_usbd_config, USB_SCD_SELF_POWERED, 100);
USBD_DESC_LANG_DEFINE(my_usbd_lang);
USBD_DESC_MANUFACTURER_DEFINE(my_usbd_manufacturer, "tinyVision.ai");
USBD_DESC_PRODUCT_DEFINE(my_usbd_product, "tinyCLUNX33");
//USBD_DESC_SERIAL_NUMBER_DEFINE(my_usbd_serial_number, "0123456789ABCDEF");

struct {
	struct usb_bos_descriptor bos;
	struct usb_bos_capability_lpm lpm;
	struct usb_bos_capability_superspeed_usb superspeed_usb;
} __packed my_usbd_bos_desc = {
	.bos = {
		.bLength = sizeof(struct usb_bos_descriptor),
		.bDescriptorType = USB_DESC_BOS,
		.wTotalLength = sys_cpu_to_le16(sizeof(my_usbd_bos_desc)),
		.bNumDeviceCaps = 2,
	},
	.lpm = {
		.bLength = sizeof(struct usb_bos_capability_lpm),
		.bDescriptorType = USB_DESC_DEVICE_CAPABILITY,
		.bDevCapabilityType = USB_BOS_CAPABILITY_EXTENSION,
		.bmAttributes = USB_BOS_ATTRIBUTES_LPM,
	},
	.superspeed_usb = {
		.bLength = sizeof(struct usb_bos_capability_superspeed_usb),
		.bDescriptorType = USB_DESC_DEVICE_CAPABILITY,
		.bDevCapabilityType = USB_BOS_CAPABILITY_SUPERSPEED_USB,
		.bmAttributes = USB_BOS_ATTRIBUTES_LPM,
		.wSpeedsSupported = sys_cpu_to_le16(USB_BOS_SPEED_SUPERSPEED_GEN1
			| USB_BOS_SPEED_HIGHSPEED | USB_BOS_SPEED_FULLSPEED),
		.bFunctionnalSupport = 1,
		.bU1DevExitLat = 10,
		.wU2DevExitLat = sys_cpu_to_le16(1023),
	},
};
static struct usbd_desc_node my_usbd_bos = {
	.desc = &my_usbd_bos_desc,
};

/* Static pool of buffer with no data in it */
NET_BUF_POOL_DEFINE(_buf_pool, 2, 0, sizeof(struct udc_buf_info), NULL);

int main(void)
{
	const struct device *raw0 = DEVICE_DT_GET(DT_NODELABEL(raw0));
	struct net_buf *buf;
	int err;

	k_sleep(K_MSEC(200));
	clock_control_on(DEVICE_DT_GET(DT_NODELABEL(pll0)), NULL);
	k_sleep(K_MSEC(200));

	err = usbd_add_descriptor(&my_usbd, &my_usbd_dev_qualifier);
	err |= usbd_add_descriptor(&my_usbd, &my_usbd_bos);
	err |= usbd_add_descriptor(&my_usbd, &my_usbd_lang);
	err |= usbd_add_descriptor(&my_usbd, &my_usbd_manufacturer);
	err |= usbd_add_descriptor(&my_usbd, &my_usbd_product);
	//err |= usbd_add_descriptor(&my_usbd, &my_usbd_serial_number);
	err |= usbd_add_configuration(&my_usbd, &my_usbd_config);
	err |= usbd_register_class(&my_usbd, "cdc_raw_0", 1);
	__ASSERT_NO_MSG(err == 0);

	err = usbd_init(&my_usbd);
	__ASSERT_NO_MSG(err == 0);

	err = usbd_enable(&my_usbd);
	__ASSERT_NO_MSG(err == 0);

	/* Allocate a buffer with existing data */
	buf = net_buf_alloc_with_data(&_buf_pool,
		(void *)0xb1100000, 1024 * 63, Z_TIMEOUT_NO_WAIT);
	__ASSERT_NO_MSG(buf != NULL);

	LOG_DBG("0");

	/* Wait that a serial console connects */
	while (!cdc_raw_is_ready(raw0)) {
		k_sleep(K_MSEC(100));
	}
	LOG_DBG("1");

	/* Then give a bit of time for the console to disconnect */
	k_sleep(K_MSEC(2000));
	LOG_DBG("2");

	/* Then perform the bulk throughput test */
	for (int i = 0;;) {
		k_sleep(K_MSEC(10));
		if (cdc_raw_write(raw0, buf) == 0) {
			LOG_INF("%d", i++);
		}
	}

	return 0;
}
```
